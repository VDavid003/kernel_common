/*
 * SAMSUNG LCD Panel Device Tree Source
 *
 * Copyright (c) 2016 Samsung Electronics Co., Ltd.
 *		http://www.samsung.com
 *
 * This program is free software; you can redistribute it and/or modify
 * it under the terms of the GNU General Public License version 2 as
 * published by the Free Software Foundation.
*/

/ {
	s6e3fa7: s6e3fa7_fhd {
		mode = <2>; /* 0: video mode, 1: DP command mode, 2: MIPI command mode */
		resolution = <1080 2220>;
		size = <67 138>;	/* 67.176 x 138.084 */
		timing,refresh = <60>;
		timing,h-porch = <2 2 2>;
		timing,v-porch = <15 3 1>;
		timing,dsi-hs-clk = <997>;
		timing,pms = <3 230 1>;
		timing,dsi-escape-clk = <16>;
		mic_en = <0>;		/* 0: Disable, 1: Enable */
		mic_ratio = <0>;	/* 0: 1/2 mic, 1: 1/3 mic */
		mic_ver = <0>;		/* 0: mic v1.1, 1: v1.2, 2: v2.0 */
		type_of_ddi = <0>;	/* 0: Samsung Mobile, 1: MAGNA, 2: Normal(Etc) */
		dsc_en = <0>;		/* 0: Disable, 1: Enable */
		dsc_cnt = <0>;		/* used DSC count */
		dsc_slice_num = <0>;	/* count of dsc slice */
		data_lane = <4>;	/* number of using data lane */
		cmd_underrun_lp_ref = <2498>;	/* for underrun detect at command mode */
	};

};
